## mh2/Kconfig
```kconfig
# Kconfig settings for MH2 processors

if MACH_MH2

config MH2_SELECT
    bool
    default y
    select HAVE_GPIO
    select HAVE_GPIO_ADC
    select HAVE_GPIO_I2C if !MACH_MH2030
    select HAVE_GPIO_SPI if !MACH_MH2030
    select HAVE_GPIO_SDIO if MACH_MH24
    select HAVE_GPIO_HARD_PWM if MACH_MH21 || MACH_MH24 || MACH_MH27
    select HAVE_STRICT_TIMING
    select HAVE_CHIPID
    select HAVE_STEPPER_BOTH_EDGE
    select HAVE_BOOTLOADER_REQUEST

config BOARD_DIRECTORY
    string
    default "mh2"


######################################################################
# Chip selection
# 2030 M0内核
# 2103 M3内核
# 24xx M4内核 
######################################################################

choice
    prompt "Processor model"
    config MACH_MH2103
        bool "MH2103"
        select MACH_MH21
    config MACH_MH2407
        bool "MH2407"
        select MACH_MH24
        select MACH_MH24x5
endchoice

config MACH_MH20
    bool
config MACH_MH21
    bool
config MACH_MH24
    bool
config HAVE_MH2_USBFS
    bool
    default y if MACH_MH21 || MACH_MH24
config HAVE_MH2_USBOTG
    bool
    default y if MACH_MH24
config HAVE_MH2_CANBUS
    bool
    default y if MACH_MH21 || MACH_MH24x5 || MACH_MH2446 || MACH_MH20x2
config HAVE_MH2_USBCANBUS
    bool
    depends on HAVE_MH2_USBFS || HAVE_MH2_USBOTG
    depends on HAVE_MH2_CANBUS || HAVE_MH2_FDCANBUS
    depends on !MACH_MH21
    default y

config MCU
    string
    default "mh2103xe" if MACH_MH2103
    default "mh2407xx" if MACH_MH2407

config FLASH_SIZE
    hex
    default 0x40000 if MACH_MH2030
    default 0x10000 if MACH_MH2103
    default 0x100000 if MACH_MH2401 || MACH_MH24x5 || MACH_MH2446

config FLASH_BOOT_ADDRESS
    hex
    default 0x8000000

config RAM_START
    hex
    default 0x20000000

config RAM_SIZE
    hex
    default 0x5000 if MACH_MH2103
    default 0x20000 if MACH_MH24x5 || MACH_MH2446

config STACK_SIZE
    int
    default 512

config MH2_DFU_ROM_ADDRESS
    hex
    default 0 if !USB
    default 0x1fff0000 if MACH_MH24
    default 0


######################################################################
# Bootloader
######################################################################

choice
    prompt "Bootloader offset"
    config MH2_FLASH_START_0000
        bool "No bootloader"
    config MH2_FLASH_START_800
        bool "2KiB bootloader (HID Bootloader)" if MACH_MH2103
    config MH2_FLASH_START_1000
        bool "4KiB bootloader (HID Bootloader)" if MACH_MH2103 || MACH_MH20
    config MH2_FLASH_START_2000
        bool "8KiB bootloader" if MACH_MH21 || MACH_MH20
    config MH2_FLASH_START_5000
        bool "20KiB bootloader" if MACH_MH2103
    config MH2_FLASH_START_8000
        bool "32KiB bootloader" if MACH_MH21 || MACH_MH24
    config MH2_FLASH_START_10000
        bool "64KiB bootloader" if MACH_MH2103 || MACH_MH24x5
endchoice
config FLASH_APPLICATION_ADDRESS
    hex
    default 0x8000800 if MH2_FLASH_START_800
    default 0x8001000 if MH2_FLASH_START_1000
    default 0x8002000 if MH2_FLASH_START_2000
    default 0x8005000 if MH2_FLASH_START_5000
    default 0x8008000 if MH2_FLASH_START_8000
    default 0x8010000 if MH2_FLASH_START_10000
    default 0x8000000

config ARMCM_RAM_VECTORTABLE
    bool
    default y if MACH_MH20 && FLASH_APPLICATION_ADDRESS != 0x8000000
    default n


######################################################################
# Clock
######################################################################
# 由于需要满足216M整数倍,因此只支持8,12,24的晶振
choice
    prompt "Clock Reference" if LOW_LEVEL_OPTIONS
    config MH2_CLOCK_REF_8M
        bool "8 MHz crystal"
    config MH2_CLOCK_REF_12M
        bool "12 MHz crystal"
    config MH2_CLOCK_REF_24M
        bool "24 MHz crystal"
    config MH2_CLOCK_REF_INTERNAL
        bool "Internal clock"
endchoice
config CLOCK_REF_FREQ
    int
    default 25000000 if MH2_CLOCK_REF_25M
    default 24000000 if MH2_CLOCK_REF_24M
    default 20000000 if MH2_CLOCK_REF_20M
    default 16000000 if MH2_CLOCK_REF_16M
    default 12000000 if MH2_CLOCK_REF_12M
    default 1 if MH2_CLOCK_REF_INTERNAL
    default 8000000

config MH20_TRIM
    int "Internal clock trim override" if LOW_LEVEL_OPTIONS && MACH_MH20 && MH2_CLOCK_REF_INTERNAL && !USBSERIAL
    default 16
    help
        Specify the internal clock trim value. Setting this can be
        useful if the factory default internal clock is not accurate.
        Default is 16 (use factory default). Each increment increases
        the clock rate by ~240KHz.


######################################################################
# System-CLK
######################################################################
choice
    prompt "System clock"
    config MH2_SYSCLK_64
        bool "64MHz" if MACH_MH2103 && MH2_CLOCK_REF_INTERNAL
    config MH2_SYSCLK_72
        bool "72MHz" if MACH_MH2103
    config MH2_SYSCLK_168
        bool "168MHz" if MACH_MH24x5 || MACH_MH2429
    config MH2_SYSCLK_216
        bool "216MHz" if MACH_MH2103 && !MH2_CLOCK_REF_INTERNAL
endchoice

config CLOCK_FREQ
    int
    default 64000000 if MH2_SYSCLK_64
    default 72000000 if MH2_SYSCLK_72
    default 168000000 if MH2_SYSCLK_168
    default 216000000 if MH2_SYSCLK_216
    default 72000000

######################################################################
# Communication inteface
######################################################################

choice
    prompt "Communication interface"
    config MH2_USB_PA11_PA12
        bool "USB (on PA11/PA12)" if HAVE_MH2_USBFS || HAVE_MH2_USBOTG
        select USBSERIAL
    config MH2_USB_PA11_PA12_REMAP
        bool "USB (on PA9/PA10)" if LOW_LEVEL_OPTIONS && MACH_MH2042
        select USBSERIAL
    config MH2_SERIAL_USART1
        bool "Serial (on USART1 PA10/PA9)"
        select SERIAL
    config MH2_SERIAL_USART1_ALT_PB7_PB6
        bool "Serial (on USART1 PB7/PB6)" if LOW_LEVEL_OPTIONS
        select SERIAL
    config MH2_SERIAL_USART2
        bool "Serial (on USART2 PA3/PA2)" if LOW_LEVEL_OPTIONS
        select SERIAL
    config MH2_SERIAL_USART2_ALT_PA15_PA14
        bool "Serial (on USART2 PA15/PA14)" if LOW_LEVEL_OPTIONS && MACH_MH20
        select SERIAL
    config MH2_SERIAL_USART2_ALT_PD6_PD5
        bool "Serial (on USART2 PD6/PD5)" if LOW_LEVEL_OPTIONS && !MACH_MH20
        select SERIAL
    config MH2_SERIAL_USART3
        bool "Serial (on USART3 PB11/PB10)" if LOW_LEVEL_OPTIONS
        depends on !MACH_MH20 && !MACH_MH2401
        select SERIAL
    config MH2_SERIAL_USART3_ALT_PD9_PD8
        bool "Serial (on USART3 PD9/PD8)" if LOW_LEVEL_OPTIONS
        depends on !MACH_MH20 && !MACH_MH2401
        select SERIAL
    config MH2_CANBUS_PA11_PA12
        bool "CAN bus (on PA11/PA12)"
        depends on HAVE_MH2_CANBUS || HAVE_MH2_FDCANBUS
        select CANSERIAL
    config MH2_CANBUS_PA11_PA12_REMAP
        bool "CAN bus (on PA9/PA10)" if LOW_LEVEL_OPTIONS
        depends on HAVE_MH2_CANBUS && MACH_MH2042
        select CANSERIAL
    config MH2_CANBUS_PA11_PB9
        bool "CAN bus (on PA11/PB9)"
        depends on !MACH_MH21 && (HAVE_MH2_CANBUS || HAVE_MH2_FDCANBUS)
        select CANSERIAL
    config MH2_MMENU_CANBUS_PB8_PB9
        bool "CAN bus (on PB8/PB9)" if LOW_LEVEL_OPTIONS
        depends on HAVE_MH2_CANBUS || HAVE_MH2_FDCANBUS
        select CANSERIAL
    config MH2_MMENU_CANBUS_PI9_PH13
        bool "CAN bus (on PI9/PH13)" if LOW_LEVEL_OPTIONS
        depends on HAVE_MH2_CANBUS && MACH_MH24
        select CANSERIAL
    config MH2_MMENU_CANBUS_PB5_PB6
        bool "CAN bus (on PB5/PB6)" if LOW_LEVEL_OPTIONS
        depends on HAVE_MH2_CANBUS && MACH_MH24
        select CANSERIAL
    config MH2_MMENU_CANBUS_PB12_PB13
        bool "CAN bus (on PB12/PB13)" if LOW_LEVEL_OPTIONS
        depends on (HAVE_MH2_CANBUS && MACH_MH24) || HAVE_MH2_FDCANBUS
        select CANSERIAL
    config MH2_MMENU_CANBUS_PD0_PD1
        bool "CAN bus (on PD0/PD1)" if LOW_LEVEL_OPTIONS
        depends on HAVE_MH2_CANBUS || HAVE_MH2_FDCANBUS
        select CANSERIAL
    config MH2_MMENU_CANBUS_PB0_PB1
        bool "CAN bus (on PB0/PB1)"
        depends on HAVE_MH2_FDCANBUS
        select CANSERIAL
    config MH2_MMENU_CANBUS_PD12_PD13
        bool "CAN bus (on PD12/PD13)"
        depends on HAVE_MH2_FDCANBUS
        select CANSERIAL
    config MH2_MMENU_CANBUS_PC2_PC3
        bool "CAN bus (on PC2/PC3)"
        depends on HAVE_MH2_FDCANBUS
        select CANSERIAL
    config MH2_USBCANBUS_PA11_PA12
        bool "USB to CAN bus bridge (USB on PA11/PA12)"
        depends on HAVE_MH2_USBCANBUS
        select USBCANBUS
endchoice
choice
    prompt "CAN bus interface" if USBCANBUS
    config MH2_CMENU_CANBUS_PB8_PB9
        bool "CAN bus (on PB8/PB9)"
    config MH2_CMENU_CANBUS_PI9_PH13
        bool "CAN bus (on PI9/PH13)"
        depends on HAVE_MH2_CANBUS && MACH_MH24
    config MH2_CMENU_CANBUS_PB5_PB6
        bool "CAN bus (on PB5/PB6)"
        depends on (HAVE_MH2_CANBUS && MACH_MH24)
    config MH2_CMENU_CANBUS_PB12_PB13
        bool "CAN bus (on PB12/PB13)"
        depends on (HAVE_MH2_CANBUS && MACH_MH24) || HAVE_MH2_FDCANBUS
    config MH2_CMENU_CANBUS_PD0_PD1
        bool "CAN bus (on PD0/PD1)"
        depends on HAVE_MH2_CANBUS || HAVE_MH2_FDCANBUS
    config MH2_CMENU_CANBUS_PB0_PB1
        bool "CAN bus (on PB0/PB1)"
        depends on HAVE_MH2_FDCANBUS
    config MH2_CMENU_CANBUS_PD12_PD13
        bool "CAN bus (on PD12/PD13)"
        depends on HAVE_MH2_FDCANBUS
    config MH2_CMENU_CANBUS_PC2_PC3
        bool "CAN bus (on PC2/PC3)"
        depends on HAVE_MH2_FDCANBUS
endchoice


config MH2_CANBUS_PB8_PB9
    bool
    default y if MH2_MMENU_CANBUS_PB8_PB9 || MH2_CMENU_CANBUS_PB8_PB9
config MH2_CANBUS_PI9_PH13
    bool
    default y if MH2_MMENU_CANBUS_PI9_PH13 || MH2_CMENU_CANBUS_PI9_PH13
config MH2_CANBUS_PB5_PB6
    bool
    default y if MH2_MMENU_CANBUS_PB5_PB6 || MH2_CMENU_CANBUS_PB5_PB6
config MH2_CANBUS_PB12_PB13
    bool
    default y if MH2_MMENU_CANBUS_PB12_PB13 || MH2_CMENU_CANBUS_PB12_PB13
config MH2_CANBUS_PD0_PD1
    bool
    default y if MH2_MMENU_CANBUS_PD0_PD1 || MH2_CMENU_CANBUS_PD0_PD1
config MH2_CANBUS_PB0_PB1
    bool
    default y if MH2_MMENU_CANBUS_PB0_PB1 || MH2_CMENU_CANBUS_PB0_PB1
config MH2_CANBUS_PD12_PD13
    bool
    default y if MH2_MMENU_CANBUS_PD12_PD13 || MH2_CMENU_CANBUS_PD12_PD13
config MH2_CANBUS_PC2_PC3
    bool
    default y if MH2_MMENU_CANBUS_PC2_PC3 || MH2_CMENU_CANBUS_PC2_PC3

endif
```
